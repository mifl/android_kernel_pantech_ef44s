## arch/arm/mach-msm/cust/Kconfig
```kconfig
if CUST_PANTECH_H

#
# PANTECH Cust feature section
#

config PANTECH_VERIZON
  bool
config PANTECH_ATNT
  bool
config PANTECH_JAPAN
  bool
config PANTECH_DOMESTIC
  bool


if MACH_MSM8960_SVLTE
config DEFINE_LIST_SVLTE
	bool
	default y
#	select PANTECH_SDCARD
#	select PANTECH_ERR_CRASH_LOGGING
endif

if MACH_MSM8960_CSFB
config DEFINE_LIST_CSFB
	bool
	default y
#	select PANTECH_SDCARD
	select PANTECH_ERR_CRASH_LOGGING
endif

if MACH_MSM8960_VEGAPVW
config DEFINE_LIST_VEGAPVW
	bool
	default y
	select PANTECH_VERIZON
#	select PANTECH_SDCARD
#	select F_SKYDISP_QBUG_FIX_BACKLIGHT
	select F_SKYDISP_BOOT_LOGO_IN_KERNEL
	select F_SKYDISP_NO_CURSOR_IN_BOOT
	select F_SKYDISP_LCD_RESET
	select F_SKYDISP_LCD_FORCE_ONOFF
	select F_SKYDISP_FORCE_ENCRYPTION_OFF
	select F_SKYDISP_SMART_DIMMING
	select PANTECH_LCD_POWEROFFSEQ_ON_PHONEOFF	
	select PANTECH_PMIC
	select PANTECH_PMIC_PWRKEY
	select PANTECH_PMIC_MAX17058
	select PANTECH_I2C_MAXIM
	select PANTECH_PMIC_RESET_REASON
	select PANTECH_BMS
	select PANTECH_CHARGER
	select PANTECH_ERR_CRASH_LOGGING
	select PANTECH_SDCARD_HIGH_VOLTAGE_FIX
	select PANTECH_FS_AUTO_REPAIR
	select PANTECH_CHARGER_WIRELESS
	select ANDROID_PANTECH_USB_ABNORMAL_CHARGER_INFO
	select PANTECH_MMC

endif

if MACH_MSM8960_EF44S
config DEFINE_LIST_EF44S
	bool
	default y
	select PANTECH_DOMESTIC
#	select PANTECH_SDCARD
#	select F_SKYDISP_QBUG_FIX_BACKLIGHT
	select F_SKYDISP_BOOT_LOGO_IN_KERNEL
	select F_SKYDISP_NO_CURSOR_IN_BOOT
	select F_SKYDISP_LCD_RESET
	select F_SKYDISP_LCD_FORCE_ONOFF
	select F_SKYDISP_FORCE_ENCRYPTION_OFF
	select PANTECH_LCD_POWEROFFSEQ_ON_PHONEOFF	
	select PANTECH_PMIC
	select PANTECH_PMIC_PWRKEY
	select PANTECH_PMIC_RESET_REASON
	select PANTECH_BMS
	select PANTECH_CHARGER
	select PANTECH_PMIC_MAX17058
	select PANTECH_ERR_CRASH_LOGGING
	select PANTECH_SDCARD_HIGH_VOLTAGE_FIX
	select PANTECH_FS_AUTO_REPAIR
	select BRCM_BT
	select ANDROID_PANTECH_USB_OTG_INTENT
	select ANDROID_PANTECH_USB_OTG_CHARGER_SUSPEND
	select ANDROID_PANTECH_USB_ABNORMAL_CHARGER_INFO
	select PANTECH_WLAN_BRCM
	select PANTECH_MMC
endif

if MACH_MSM8960_MAGNUS
config DEFINE_LIST_MAGNUS
	bool
	default y
	select PANTECH_ATNT
#	select PANTECH_SDCARD
	select PANTECH_ERR_CRASH_LOGGING
	select PANTECH_PMIC
	select PANTECH_PMIC_PWRKEY
	select PANTECH_PMIC_RESET_REASON
	select PANTECH_BMS
	select PANTECH_CHARGER
	select PANTECH_PMIC_MAX17058
#	select F_SKYDISP_QBUG_FIX_BACKLIGHT
	select F_SKYDISP_BOOT_LOGO_IN_KERNEL
	select F_SKYDISP_FORCE_ENCRYPTION_OFF
	select F_SKYDISP_NO_CURSOR_IN_BOOT
	select F_SKYDISP_LCD_RESET
	select F_SKYDISP_LCD_FORCE_ONOFF
	select PANTECH_LCD_POWEROFFSEQ_ON_PHONEOFF	
	select PANTECH_SDCARD_HIGH_VOLTAGE_FIX
	select ANDROID_PANTECH_USB_ABNORMAL_CHARGER_INFO
	select PANTECH_MMC
endif


#config PANTECH_SDCARD
#	bool

config PANTECH_ERR_CRASH_LOGGING
	bool

config PANTECH_SDCARD_HIGH_VOLTAGE_FIX
	bool

config PANTECH_FS_AUTO_REPAIR
	bool

config PANTECH_PMIC
	bool

config PANTECH_PMIC_PWRKEY
	bool

config PANTECH_PMIC_MAX17058
	bool

config PANTECH_I2C_MAXIM
	bool
	
config PANTECH_PMIC_RESET_REASON
	bool
	
config PANTECH_BMS
	bool
	select PANTECH_BMS_UPDATE
	select PANTECH_BMS_BATTERY_TYPE
	select PANTECH_BMS_TEST
config PANTECH_BMS_UPDATE
	bool
config PANTECH_BMS_BATTERY_TYPE
	bool	
config PANTECH_BMS_TEST
	bool
	
config PANTECH_CHARGER
	bool
	select PANTECH_CHARGER_OFFLINE
config PANTECH_CHARGER_OFFLINE
	bool

config PANTECH_CHARGER_WIRELESS
	bool

config PANTECH_SMB_CHARGER
	bool
comment "PANTECH USB Driver"
config ANDROID_PANTECH_USB
  bool "PANTECH USB"
  default y
	 help
     Support Pantech USB

config ANDROID_PANTECH_USB_MANAGER
  depends on ANDROID_PANTECH_USB
  bool "PANTECH USB Manager"
  default y
  help
     Support Pantech USB Manager

config ANDROID_PANTECH_USB_CDFREE
  depends on ANDROID_PANTECH_USB && PANTECH_VERIZON
  bool "PANTECH USB Cdfree"
  default y
	 help
     Support Pantech USB Cdfree 

config ANDROID_PANTECH_USB_FACTORY_CABLE
  depends on ANDROID_PANTECH_USB
  bool "PANTECH USB FACTORY CABLE"
  default y
	 help
     Support Pantech USB

config ANDROID_PANTECH_USB_OTG_MODE
  depends on ANDROID_PANTECH_USB
  bool "PANTECH USB OTG mode"
  default n
	 help
     Support Pantech USB OTG mode

config ANDROID_PANTECH_USB_OTG_INTENT
  depends on ANDROID_PANTECH_USB
  bool "PANTECH USB OTG Intent"
  default n
	 help
     Support Pantech USB OTG Intent

config ANDROID_PANTECH_USB_OTG_CHARGER_SUSPEND
  depends on ANDROID_PANTECH_USB
  bool "PANTECH USB OTG Charger suspend"
  default n
	 help
     Support Pantech USB OTG Intent

config ANDROID_PANTECH_USB_ABNORMAL_CHARGER_INFO
 depends on ANDROID_PANTECH_USB
  bool "PANTECH USB Charger cable abnormal case"
  default n
	 help
     Support Pantech USB

# LCD 
#config F_SKYDISP_QBUG_FIX_BACKLIGHT
#        bool 

config F_SKYDISP_BOOT_LOGO_IN_KERNEL
        bool 

config F_SKYDISP_NO_CURSOR_IN_BOOT
        bool 
        
config F_SKYDISP_LCD_RESET
        bool 

config F_SKYDISP_LCD_FORCE_ONOFF
        bool 

config F_SKYDISP_SMART_DIMMING
        bool 
        
config F_SKYDISP_FORCE_ENCRYPTION_OFF
        bool 

config PANTECH_LCD_POWEROFFSEQ_ON_PHONEOFF
	bool
        
# SD CARD
config PANTECH_NO_EMMC_SDCARD
	bool
	
config PANTECH_MMC
	bool

# PANTECH SOUND
config PANTECH_SND
    bool "PANTECH SOUND CONFIGS"
        default y
        help
            Support Pantech Sound configs

config PANTECH_GPIO_SLEEP_CONFIG
       bool "PANTECH GPIO SLEEP CONFIG"
       default y

config BRCM_BT
	bool "BRCM BT CONFIG"
	default y    
        help
            Support Broadcom bluetooth configs       
 
config PANTECH_WLAN_BRCM
	bool "Broadcom BCM4334 driver"
	depends on ARCH_MSM8960 && !WCNSS_CORE
	select MMC_MSM_SDC4_SUPPORT
	#select BCMDHD
	#select WIRELESS_EXT
	select SKY_WLAN_MMC
	select SKY_PANMAC
	#select KSKY_RAWDATA
	---help---
	  Broadcom driver for connectivity system	  	

config SKY_WLAN_MMC
	bool		

config SKY_PANMAC
	bool "Device file for accessing MAC"

config KSKY_RAWDATA
	bool "sky_rawdata facility for kernel space"

endif
```

## drivers/dmb/Kconfig
```kconfig
#
# For a description of the syntax of this configuration file,
# see Documentation/kbuild/kconfig-language.txt.
#
# DMB configuration.
#

menu "DMB - Digital Multimedia Broadcasting"

config SKY_DMB
  bool "SKY_DMB support"
  default n
  ---help---
   Say Y here if you have a DMB device

   If unsure, say Y.


if SKY_DMB

config SKY_DMB_MODULE
  tristate "SKY_DMB_MODULE"
  default n
  depends on SKY_DMB
  ---help---
   select this option for "DMB" hardware support

###################################################################
# DMB

config SKY_TDMB
  bool "SKY_TDMB"
  default n
  depends on SKY_DMB
  ---help---
   select this option for "TDMB" hardware support

config SKY_ISDBT
  bool "SKY_ISDBT"
  default n
  depends on SKY_DMB
  ---help---
   select this option for "ISDBT" hardware support

config SKY_ISDBTMM
  bool "SKY_ISDBTMM"
  default n
  depends on SKY_DMB
  ---help---
   select this option for "ISDBTMM" hardware support

###################################################################
# TDMB BB Interface

config SKY_DMB_EBI_IF
  bool "SKY_DMB_EBI_IF"
  default n
  depends on SKY_DMB
  ---help---
   select this option for "DMB_EBI_IF" hardware support


if SKY_DMB_EBI_IF

config SKY_DMB_EBI_CMD
  bool "SKY_DMB_EBI_CMD"
  default n
  depends on SKY_DMB_EBI_IF
  ---help---
   select this option for "DMB_EBI_IF" hardware support

endif # SKY_DMB_EBI_IF


config SKY_DMB_TSIF_IF
  bool "SKY_DMB_TSIF_IF"
  default n
  depends on SKY_DMB
  ---help---
   select this option for "DMB_TSIF_IF" hardware support


config SKY_DMB_I2C_CMD
  bool "SKY_DMB_I2C_CMD"
  default n
  depends on SKY_DMB_TSIF_IF
  ---help---
   select this option for "DMB_I2C_CMD" hardware support


if SKY_DMB_I2C_CMD

config SKY_DMB_I2C_HW
  bool "SKY_DMB_I2C_HW"
  default n
  depends on SKY_DMB_I2C_CMD
  ---help---
   select this option for "DMB_I2C_CMD" hardware support


config SKY_DMB_I2C_GPIO
  bool "SKY_DMB_I2C_GPIO"
  default n
  depends on SKY_DMB_I2C_CMD
  ---help---
   select this option for "DMB_I2C_CMD" hardware support

endif # SKY_DMB_I2C_CMD


config SKY_DMB_SPI_IF
  bool "SKY_DMB_SPI_IF"
  default n
  depends on SKY_DMB
  ---help---
   select this option for "DMB_SPI_IF" hardware support


if SKY_DMB_SPI_IF

config SKY_DMB_SPI_CMD
  bool "SKY_DMB_SPI_CMD"
  default n
  depends on SKY_DMB_SPI_IF
  ---help---
   select this option for "DMB_SPI_IF" hardware support

config SKY_DMB_SPI_HW
  bool "SKY_DMB_SPI_HW"
  default n
  depends on SKY_DMB_SPI_IF
  ---help---
   select this option for "DMB_SPI_IF" hardware support

config SKY_DMB_SPI_TEGRA
  bool "SKY_DMB_SPI_TEGRA"
  default n
  depends on SKY_DMB_SPI_IF
  ---help---
   select this option for "DMB_SPI_IF" hardware support

config SKY_DMB_SPI_GPIO
  bool "SKY_DMB_SPI_GPIO"
  default n
  depends on SKY_DMB_SPI_IF
  ---help---
   select this option for "DMB_SPI_IF" hardware support

endif # SKY_DMB_SPI_IF


###################################################################
# DMB PMIC CLOCK

config SKY_DMB_PMIC_19200
  bool "SKY_DMB_PMIC_19200"
  default n
  depends on SKY_DMB
  ---help---
   select this option for "DMB" hardware support


###################################################################

if SKY_TDMB
  source "drivers/dmb/tdmb/Kconfig"
endif # SKY_TDMB

if SKY_ISDBT
  source "drivers/dmb/isdbt/Kconfig"
endif # SKY_ISDBT

if SKY_ISDBTMM
  source "drivers/dmb/isdbtmm/Kconfig"
endif # SKY_ISDBTMM


endif # SKY_DMB

endmenu
```

## drivers/dmb/isdbt/Kconfig
```kconfig
#
# For a description of the syntax of this configuration file,
# see Documentation/kbuild/kconfig-language.txt.
#
# ISDBT configuration.
#

menu "ISDBT"

if SKY_ISDBT

###################################################################
# ISDBT BB Chip

config SKY_ISDBT_SHARP_BB
  bool "SKY_ISDBT_SHARP_BB"
  default n
  depends on SKY_ISDBT
  ---help---
   select this option for "ISDBT" hardware support


endif # SKY_ISDBT

endmenu
```

## drivers/dmb/isdbtmm/Kconfig
```kconfig
#
# For a description of the syntax of this configuration file,
# see Documentation/kbuild/kconfig-language.txt.
#
# ISDBTmm configuration.
#

menu "ISDBTMM"

if SKY_ISDBTMM

###################################################################
# ISDBTMM BB Chip

config CONFIG_SKY_ISDBTMM_SHARP_BB
  bool "CONFIG_SKY_ISDBTMM_SHARP_BB"
  default n
  depends on SKY_ISDBTMM
  ---help---
   select this option for "ISDBTMM" hardware support


endif # SKY_ISDBTMM

endmenu
```

## drivers/dmb/tdmb/Kconfig
```kconfig
#
# For a description of the syntax of this configuration file,
# see Documentation/kbuild/kconfig-language.txt.
#
# TDMB configuration.
#

menu "TDMB - Terrestrial Digital Multimedia Broadcasting"

###################################################################
# TDMB BB Chip

config SKY_TDMB_INC_BB
  bool "SKY_TDMB_INC_BB"
  default n
  depends on SKY_TDMB
  ---help---
   select this option for "TDMB" hardware support


if SKY_TDMB_INC_BB

config SKY_TDMB_INC_BB_T3700
  bool "SKY_TDMB_INC_BB_T3700"
  default n
  depends on SKY_TDMB_INC_BB
  ---help---
   select this option for "TDMB" hardware support


config SKY_TDMB_INC_BB_T3900
  bool "SKY_TDMB_INC_BB_T3900"
  default n
  depends on SKY_TDMB_INC_BB
  ---help---
   select this option for "TDMB" hardware support

endif # SKY_TDMB_INC_BB


config SKY_TDMB_FCI_BB
  bool "SKY_TDMB_FCI_BB"
  default n
  depends on SKY_TDMB
  ---help---
   select this option for "TDMB" hardware support


if SKY_TDMB_FCI_BB

config SKY_TDMB_FCI_BB_FC8050
  bool "SKY_TDMB_FCI_BB_FC8050"
  default n
  depends on SKY_TDMB_FCI_BB
  ---help---
   select this option for "TDMB" hardware support

endif # SKY_TDMB_FCI_BB


config SKY_TDMB_TCC_BB
  bool "SKY_TDMB_TCC_BB"
  default n
  depends on SKY_TDMB
  ---help---
   select this option for "TDMB" hardware support

if SKY_TDMB_TCC_BB

config SKY_TDMB_TCC_BB_TCC3170
  bool "SKY_TDMB_TCC_BB_TCC3170"
  default n
  depends on SKY_TDMB_TCC_BB
  ---help---
   select this option for "TDMB" hardware support

endif # SKY_TDMB_TCC_BB


config SKY_TDMB_RTV_BB
  bool "SKY_TDMB_RTV_BB"
  default n
  depends on SKY_TDMB
  ---help---
   select this option for "TDMB" hardware support


if SKY_TDMB_RTV_BB

config SKY_TDMB_RTV_BB_MTV350
  bool "SKY_TDMB_RTV_BB_MTV350"
  default n
  depends on SKY_TDMB_RTV_BB
  ---help---
   select this option for "TDMB" hardware support

endif # SKY_TDMB_RTV_BB


###################################################################
# TDMB ANT PATH

config SKY_TDMB_MICRO_USB_DETECT
  bool "SKY_TDMB_MICRO_USB_DETECT"
  default n
  depends on SKY_TDMB
  ---help---
   select this option for "TDMB" hardware support


###################################################################

endmenu
```

## drivers/net/wireless/bcmdhd_sky/Kconfig
```kconfig
config BCMDHD
	tristate "Broadcom 4330/34 wireless cards support"
	depends on MMC
	---help---
	  This module adds support for wireless adapters based on
	  Broadcom 4330/34 chipset.

	  This driver uses the kernel's wireless extensions subsystem.

	  If you choose to build a module, it'll be called dhd. Say M if
	  unsure.

config BCMDHD_FW_PATH
	depends on BCMDHD
	string "Firmware path"
	default "/system/vendor/firmware/fw_bcmdhd.bin"
	---help---
	  Path to the firmware file.
		
config BCMDHD_NVRAM_PATH
	depends on BCMDHD
	string "NVRAM path"
	default "/system/etc/nv_bcmdhd.txt"
	---help---
	  Path to the calibration file.

config DHD_USE_STATIC_BUF
	depends on BCMDHD
	bool "Use static buffer in os_malloc"
	default n
	---help---
	  Use static buffer in os_malloc
```
